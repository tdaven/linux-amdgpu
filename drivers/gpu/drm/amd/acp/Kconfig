## drivers/gpu/drm/amd/acp/Kconfig
```kconfig
menu "ACP Configuration"

config DRM_AMD_ACP
       bool "Enable ACP IP support"
       default y
       depends on MFD_CORE
       help
	Choose this option to enable ACP IP support for AMD SOCs.

endmenu
```

## drivers/gpu/drm/amd/hdcp_service/Kconfig
```kconfig
menu "HDCP service configuration"

config DRM_AMD_HDCP_SERVICE
       bool "Enable HDCP security service support"
       default y
       help
        Choose this option to enable HDCP security service component for AMD SOCs.
endmenu
```

## sound/soc/amd/Kconfig
```kconfig
config SND_SOC_AMD_ACP
	tristate "AMD Audio Coprocessor support"
	depends on MFD_CORE
	help
	 This option enables ACP support (DMA,I2S) on AMD platforms.
```
